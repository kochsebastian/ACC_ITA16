ASAP2_VERSION 1 41
/begin PROJECT ACC_PC "Generated by ETAS from Project ACC_PC"
/begin HEADER "" VERSION "000" PROJECT_NO ASD /end HEADER
/begin MODULE ACC_PC "Generated by ETAS ASCET7 from Project: ACC_PC"
/begin IF_DATA E_TARGET
 /begin SOURCE "Task0" 3 /* period */ 10 QP_BLOB 1 /end SOURCE
 /begin TP_BLOB /* programm id */ 671120470 /* target id */ 7 0 2 0 /end TP_BLOB
/end IF_DATA
/begin MOD_PAR "" VERSION "000" ADDR_EPK 0x0 EPK "" SUPPLIER "ETAS GmbH" CUSTOMER "xxx" CUSTOMER_NO "000" USER "xxx" PHONE_NO "000" ECU "PC" CPU_TYPE "PCx86" NO_OF_INTERFACES 1 /end MOD_PAR
/begin MOD_COMMON "Common definitions" BYTE_ORDER MSB_LAST ALIGNMENT_BYTE 1 ALIGNMENT_WORD 2 ALIGNMENT_LONG 4 ALIGNMENT_FLOAT32_IEEE 4 ALIGNMENT_FLOAT64_IEEE 8 /end MOD_COMMON
/begin CHARACTERISTIC components.Globals.acc_status_request "" VALUE 0x451044 STANDARD_VALUE_U8 0.0 esdl_ident 0 1 BIT_MASK 0x1 /end CHARACTERISTIC
/begin CHARACTERISTIC components.Sim.s.BrakeMomentum "" CURVE 0x43403C STANDARD_CURVE_R32R32 0.0 esdl_ident -3.4028234663852886E+38 3.4028234663852886E+38
 /begin AXIS_DESCR STD_AXIS NO_INPUT_QUANTITY esdl_ident 6 -3.4028234663852886E+38 3.4028234663852886E+38 /end AXIS_DESCR
/end CHARACTERISTIC
/begin CHARACTERISTIC components.Sim.s.EngineMomentum "" MAP 0x434070 STANDARD_MAP_R32R32R32 0.0 esdl_ident -3.4028234663852886E+38 3.4028234663852886E+38
 /begin AXIS_DESCR STD_AXIS NO_INPUT_QUANTITY esdl_ident 6 -3.4028234663852886E+38 3.4028234663852886E+38 /end AXIS_DESCR
 /begin AXIS_DESCR STD_AXIS NO_INPUT_QUANTITY esdl_ident 6 -3.4028234663852886E+38 3.4028234663852886E+38 /end AXIS_DESCR
/end CHARACTERISTIC
/begin CHARACTERISTIC components.Sim.s.AirFriction "" CURVE 0x434008 STANDARD_CURVE_R32R32 0.0 esdl_ident -3.4028234663852886E+38 3.4028234663852886E+38
 /begin AXIS_DESCR STD_AXIS NO_INPUT_QUANTITY esdl_ident 6 -3.4028234663852886E+38 3.4028234663852886E+38 /end AXIS_DESCR
/end CHARACTERISTIC
/begin CHARACTERISTIC components.Sim.s.Landscape "" CURVE 0x434134 STANDARD_CURVE_R32R32 0.0 esdl_ident -3.4028234663852886E+38 3.4028234663852886E+38
 /begin AXIS_DESCR STD_AXIS NO_INPUT_QUANTITY esdl_ident 20 -3.4028234663852886E+38 3.4028234663852886E+38 /end AXIS_DESCR
/end CHARACTERISTIC
/begin CHARACTERISTIC components.Sim.s.TrackSize "" VALUE 0x434004 STANDARD_VALUE_R32 0.0 esdl_ident -3.4028234663852886E+38 3.4028234663852886E+38 /end CHARACTERISTIC
/begin CHARACTERISTIC components.Sim.a.c "" VALUE 0x434000 STANDARD_VALUE_R32 0.0 esdl_ident -3.4028234663852886E+38 3.4028234663852886E+38 /end CHARACTERISTIC
/begin MEASUREMENT components.Globals.acc_status "" UBYTE esdl_ident 1 100.0 0 1 ECU_ADDRESS 0x451045 BIT_MASK 0x1 /end MEASUREMENT
/begin MEASUREMENT components.Globals.acc_feedback "" UBYTE esdl_ident 1 100.0 0 1 ECU_ADDRESS 0x451046 BIT_MASK 0x1 /end MEASUREMENT
/begin MEASUREMENT components.Globals.v "" FLOAT32_IEEE esdl_ident 1 100.0 -3.4028234663852886E+38 3.4028234663852886E+38 ECU_ADDRESS 0x451040 /end MEASUREMENT
/begin MEASUREMENT components.Sim.s.h "" FLOAT32_IEEE esdl_ident 1 100.0 -3.4028234663852886E+38 3.4028234663852886E+38 ECU_ADDRESS 0x451034 /end MEASUREMENT
/begin MEASUREMENT components.Sim.s.s "" FLOAT32_IEEE esdl_ident 1 100.0 -3.4028234663852886E+38 3.4028234663852886E+38 ECU_ADDRESS 0x45103C /end MEASUREMENT
/begin MEASUREMENT components.Sim.s.ds "" FLOAT32_IEEE esdl_ident 1 100.0 -3.4028234663852886E+38 3.4028234663852886E+38 ECU_ADDRESS 0x451030 /end MEASUREMENT
/begin MEASUREMENT components.Sim.s.momentum "" FLOAT32_IEEE esdl_ident 1 100.0 -3.4028234663852886E+38 3.4028234663852886E+38 ECU_ADDRESS 0x451038 /end MEASUREMENT
/begin MEASUREMENT components.Sim.s.dh "" FLOAT32_IEEE esdl_ident 1 100.0 -3.4028234663852886E+38 3.4028234663852886E+38 ECU_ADDRESS 0x45102C /end MEASUREMENT
/begin MEASUREMENT components.Sim.a.acc_status_old "" UBYTE esdl_ident 1 100.0 0 1 ECU_ADDRESS 0x451028 BIT_MASK 0x1 /end MEASUREMENT
/begin MEASUREMENT components.Sim.a.feedback "" UBYTE esdl_ident 1 100.0 0 1 ECU_ADDRESS 0x451029 BIT_MASK 0x1 /end MEASUREMENT
/begin MEASUREMENT components.Sim.a.duration "" FLOAT32_IEEE esdl_ident 1 100.0 -3.4028234663852886E+38 3.4028234663852886E+38 ECU_ADDRESS 0x451024 /end MEASUREMENT
/begin COMPU_METHOD esdl_ident "" RAT_FUNC /* format */ "%12.4" /* unit */ "" /* coeffs */ COEFFS 0 1 0 0 0 1 /end COMPU_METHOD
/begin FUNCTION ACC_PC "" /begin SUB_FUNCTION components.Globals components.Sim /end SUB_FUNCTION /end FUNCTION
/begin FUNCTION components.Globals "" /begin DEF_CHARACTERISTIC components.Globals.acc_status_request /end DEF_CHARACTERISTIC
 /begin LOC_MEASUREMENT components.Globals.acc_feedback components.Globals.acc_status components.Globals.v /end LOC_MEASUREMENT
/end FUNCTION
/begin FUNCTION components.Sim "" /begin SUB_FUNCTION components.Sim.s components.Sim.o components.Sim.a /end SUB_FUNCTION /end FUNCTION
/begin FUNCTION components.Sim.s ""
 /begin DEF_CHARACTERISTIC components.Sim.s.BrakeMomentum components.Sim.s.EngineMomentum components.Sim.s.AirFriction components.Sim.s.Landscape components.Sim.s.TrackSize /end DEF_CHARACTERISTIC
 /begin LOC_MEASUREMENT components.Sim.s.dh components.Sim.s.ds components.Sim.s.h components.Sim.s.momentum components.Sim.s.s /end LOC_MEASUREMENT
/end FUNCTION
/begin FUNCTION components.Sim.o "" /end FUNCTION
/begin FUNCTION components.Sim.a "" /begin DEF_CHARACTERISTIC components.Sim.a.c /end DEF_CHARACTERISTIC
 /begin LOC_MEASUREMENT components.Sim.a.acc_status_old components.Sim.a.duration components.Sim.a.feedback /end LOC_MEASUREMENT
/end FUNCTION
/begin RECORD_LAYOUT STANDARD_VALUE_U8 FNC_VALUES 1 UBYTE COLUMN_DIR DIRECT /end RECORD_LAYOUT
/begin RECORD_LAYOUT STANDARD_CURVE_R32R32 /* axis size */ NO_AXIS_PTS_X 1 UWORD /* axis */ AXIS_PTS_X 2 FLOAT32_IEEE INDEX_INCR DIRECT FNC_VALUES 3 FLOAT32_IEEE COLUMN_DIR DIRECT /end RECORD_LAYOUT
/begin RECORD_LAYOUT STANDARD_MAP_R32R32R32 /* x axis size */ NO_AXIS_PTS_X 1 UWORD /* y axis size */ NO_AXIS_PTS_Y 2 UWORD /* x axis */ AXIS_PTS_X 3 FLOAT32_IEEE INDEX_INCR DIRECT /* y axis */ AXIS_PTS_Y 4 FLOAT32_IEEE INDEX_INCR DIRECT FNC_VALUES 5 FLOAT32_IEEE COLUMN_DIR DIRECT /end RECORD_LAYOUT
/begin RECORD_LAYOUT STANDARD_VALUE_R32 FNC_VALUES 1 FLOAT32_IEEE COLUMN_DIR DIRECT /end RECORD_LAYOUT
/begin GROUP ACC_PC "" ROOT /begin SUB_GROUP components.Globals components.Sim /end SUB_GROUP /end GROUP
/begin GROUP components.Globals "" /begin REF_CHARACTERISTIC components.Globals.acc_status_request /end REF_CHARACTERISTIC
 /begin REF_MEASUREMENT components.Globals.acc_feedback components.Globals.acc_status components.Globals.v /end REF_MEASUREMENT
/end GROUP
/begin GROUP components.Sim "" /begin SUB_GROUP components.Sim.s components.Sim.o components.Sim.a /end SUB_GROUP /end GROUP
/begin GROUP components.Sim.s ""
 /begin REF_CHARACTERISTIC components.Sim.s.BrakeMomentum components.Sim.s.EngineMomentum components.Sim.s.AirFriction components.Sim.s.Landscape components.Sim.s.TrackSize /end REF_CHARACTERISTIC
 /begin REF_MEASUREMENT components.Sim.s.dh components.Sim.s.ds components.Sim.s.h components.Sim.s.momentum components.Sim.s.s /end REF_MEASUREMENT
/end GROUP
/begin GROUP components.Sim.o "" /end GROUP
/begin GROUP components.Sim.a "" /begin REF_CHARACTERISTIC components.Sim.a.c /end REF_CHARACTERISTIC
 /begin REF_MEASUREMENT components.Sim.a.acc_status_old components.Sim.a.duration components.Sim.a.feedback /end REF_MEASUREMENT
/end GROUP
/end MODULE
/end PROJECT
