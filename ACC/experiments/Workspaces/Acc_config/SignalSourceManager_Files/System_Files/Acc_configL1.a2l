ASAP2_VERSION 1 41
/begin PROJECT Acc_config "Generated by ETAS from Project Acc_config"
/begin HEADER "" VERSION "000" PROJECT_NO ASD /end HEADER
/begin MODULE Acc_config "Generated by ETAS ASCET7 from Project: Acc_config"
/begin IF_DATA E_TARGET
 /begin SOURCE "Task0" 3 /* period */ 10 QP_BLOB 1 /end SOURCE
 /begin TP_BLOB /* programm id */ 3833614106 /* target id */ 7 0 2 0 /end TP_BLOB
/end IF_DATA
/begin MOD_PAR "" VERSION "000" ADDR_EPK 0x0 EPK "" SUPPLIER "ETAS GmbH" CUSTOMER "xxx" CUSTOMER_NO "000" USER "xxx" PHONE_NO "000" ECU "PC" CPU_TYPE "PCx86" NO_OF_INTERFACES 1 /end MOD_PAR
/begin MOD_COMMON "Common definitions" BYTE_ORDER MSB_LAST ALIGNMENT_BYTE 1 ALIGNMENT_WORD 2 ALIGNMENT_LONG 4 ALIGNMENT_FLOAT32_IEEE 4 ALIGNMENT_FLOAT64_IEEE 8 /end MOD_COMMON
/begin CHARACTERISTIC components.Globals.acc_status_request "" VALUE 0x451034 STANDARD_VALUE_U8 0.0 esdl_ident 0 1 BIT_MASK 0x1 /end CHARACTERISTIC
/begin CHARACTERISTIC components.Stecke.BrakeMomentum "" CURVE 0x434038 STANDARD_CURVE_R32R32 0.0 esdl_ident -3.4028234663852886E+38 3.4028234663852886E+38
 /begin AXIS_DESCR STD_AXIS NO_INPUT_QUANTITY esdl_ident 6 -3.4028234663852886E+38 3.4028234663852886E+38 /end AXIS_DESCR
/end CHARACTERISTIC
/begin CHARACTERISTIC components.Stecke.EngineMomentum "" MAP 0x43406C STANDARD_MAP_R32R32R32 0.0 esdl_ident -3.4028234663852886E+38 3.4028234663852886E+38
 /begin AXIS_DESCR STD_AXIS NO_INPUT_QUANTITY esdl_ident 6 -3.4028234663852886E+38 3.4028234663852886E+38 /end AXIS_DESCR
 /begin AXIS_DESCR STD_AXIS NO_INPUT_QUANTITY esdl_ident 6 -3.4028234663852886E+38 3.4028234663852886E+38 /end AXIS_DESCR
/end CHARACTERISTIC
/begin CHARACTERISTIC components.Stecke.AirFriction "" CURVE 0x434004 STANDARD_CURVE_R32R32 0.0 esdl_ident -3.4028234663852886E+38 3.4028234663852886E+38
 /begin AXIS_DESCR STD_AXIS NO_INPUT_QUANTITY esdl_ident 6 -3.4028234663852886E+38 3.4028234663852886E+38 /end AXIS_DESCR
/end CHARACTERISTIC
/begin CHARACTERISTIC components.Stecke.Landscape "" CURVE 0x434130 STANDARD_CURVE_R32R32 0.0 esdl_ident -3.4028234663852886E+38 3.4028234663852886E+38
 /begin AXIS_DESCR STD_AXIS NO_INPUT_QUANTITY esdl_ident 20 -3.4028234663852886E+38 3.4028234663852886E+38 /end AXIS_DESCR
/end CHARACTERISTIC
/begin CHARACTERISTIC components.Stecke.TrackSize "" VALUE 0x434000 STANDARD_VALUE_R32 0.0 esdl_ident -3.4028234663852886E+38 3.4028234663852886E+38 /end CHARACTERISTIC
/begin CHARACTERISTIC components.AccFeedback.c "" VALUE 0x45102C STANDARD_VALUE_R32 0.0 esdl_ident -3.4028234663852886E+38 3.4028234663852886E+38 /end CHARACTERISTIC
/begin MEASUREMENT components.Globals.acc_status "" UBYTE esdl_ident 1 100.0 0 1 ECU_ADDRESS 0x451035 BIT_MASK 0x1 /end MEASUREMENT
/begin MEASUREMENT components.Globals.acc_feedback "" UBYTE esdl_ident 1 100.0 0 1 ECU_ADDRESS 0x451036 BIT_MASK 0x1 /end MEASUREMENT
/begin MEASUREMENT components.Globals.v "" FLOAT32_IEEE esdl_ident 1 100.0 -3.4028234663852886E+38 3.4028234663852886E+38 ECU_ADDRESS 0x451030 /end MEASUREMENT
/begin MEASUREMENT components.Stecke.h "" FLOAT32_IEEE esdl_ident 1 100.0 -3.4028234663852886E+38 3.4028234663852886E+38 ECU_ADDRESS 0x451040 /end MEASUREMENT
/begin MEASUREMENT components.Stecke.s "" FLOAT32_IEEE esdl_ident 1 100.0 -3.4028234663852886E+38 3.4028234663852886E+38 ECU_ADDRESS 0x451048 /end MEASUREMENT
/begin MEASUREMENT components.Stecke.ds "" FLOAT32_IEEE esdl_ident 1 100.0 -3.4028234663852886E+38 3.4028234663852886E+38 ECU_ADDRESS 0x45103C /end MEASUREMENT
/begin MEASUREMENT components.Stecke.momentum "" FLOAT32_IEEE esdl_ident 1 100.0 -3.4028234663852886E+38 3.4028234663852886E+38 ECU_ADDRESS 0x451044 /end MEASUREMENT
/begin MEASUREMENT components.Stecke.dh "" FLOAT32_IEEE esdl_ident 1 100.0 -3.4028234663852886E+38 3.4028234663852886E+38 ECU_ADDRESS 0x451038 /end MEASUREMENT
/begin MEASUREMENT components.AccFeedback.acc_status_old "" UBYTE esdl_ident 1 100.0 0 1 ECU_ADDRESS 0x451028 BIT_MASK 0x1 /end MEASUREMENT
/begin MEASUREMENT components.AccFeedback.feedback "" UBYTE esdl_ident 1 100.0 0 1 ECU_ADDRESS 0x451029 BIT_MASK 0x1 /end MEASUREMENT
/begin MEASUREMENT components.AccFeedback.duration "" FLOAT32_IEEE esdl_ident 1 100.0 -3.4028234663852886E+38 3.4028234663852886E+38 ECU_ADDRESS 0x451024 /end MEASUREMENT
/begin MEASUREMENT interfaces.interfaces.crash_detected "" UBYTE esdl_ident 1 100.0 0 1 ECU_ADDRESS 0x45104D BIT_MASK 0x1 /end MEASUREMENT
/begin MEASUREMENT interfaces.interfaces.plusButtonPressed "" UBYTE esdl_ident 1 100.0 0 1 ECU_ADDRESS 0x45104C BIT_MASK 0x1 /end MEASUREMENT
/begin COMPU_METHOD esdl_ident "" RAT_FUNC /* format */ "%12.4" /* unit */ "" /* coeffs */ COEFFS 0 1 0 0 0 1 /end COMPU_METHOD
/begin FUNCTION Acc_config ""
 /begin SUB_FUNCTION components.Globals components.Stecke components.AccFeedback components.OnOff components.FuSi /end SUB_FUNCTION
/end FUNCTION
/begin FUNCTION components.Globals "" /begin DEF_CHARACTERISTIC components.Globals.acc_status_request /end DEF_CHARACTERISTIC
 /begin LOC_MEASUREMENT components.Globals.acc_feedback components.Globals.acc_status components.Globals.v /end LOC_MEASUREMENT
/end FUNCTION
/begin FUNCTION components.Stecke ""
 /begin DEF_CHARACTERISTIC components.Stecke.BrakeMomentum components.Stecke.EngineMomentum components.Stecke.AirFriction components.Stecke.Landscape components.Stecke.TrackSize /end DEF_CHARACTERISTIC
 /begin LOC_MEASUREMENT components.Stecke.dh components.Stecke.ds components.Stecke.h components.Stecke.momentum components.Stecke.s /end LOC_MEASUREMENT
/end FUNCTION
/begin FUNCTION components.AccFeedback "" /begin DEF_CHARACTERISTIC components.AccFeedback.c /end DEF_CHARACTERISTIC
 /begin LOC_MEASUREMENT components.AccFeedback.acc_status_old components.AccFeedback.duration components.AccFeedback.feedback /end LOC_MEASUREMENT
/end FUNCTION
/begin FUNCTION components.OnOff "" /end FUNCTION
/begin FUNCTION components.FuSi "" /begin IN_MEASUREMENT interfaces.interfaces.crash_detected /end IN_MEASUREMENT /end FUNCTION
/begin RECORD_LAYOUT STANDARD_VALUE_U8 FNC_VALUES 1 UBYTE COLUMN_DIR DIRECT /end RECORD_LAYOUT
/begin RECORD_LAYOUT STANDARD_CURVE_R32R32 /* axis size */ NO_AXIS_PTS_X 1 UWORD /* axis */ AXIS_PTS_X 2 FLOAT32_IEEE INDEX_INCR DIRECT FNC_VALUES 3 FLOAT32_IEEE COLUMN_DIR DIRECT /end RECORD_LAYOUT
/begin RECORD_LAYOUT STANDARD_MAP_R32R32R32 /* x axis size */ NO_AXIS_PTS_X 1 UWORD /* y axis size */ NO_AXIS_PTS_Y 2 UWORD /* x axis */ AXIS_PTS_X 3 FLOAT32_IEEE INDEX_INCR DIRECT /* y axis */ AXIS_PTS_Y 4 FLOAT32_IEEE INDEX_INCR DIRECT FNC_VALUES 5 FLOAT32_IEEE COLUMN_DIR DIRECT /end RECORD_LAYOUT
/begin RECORD_LAYOUT STANDARD_VALUE_R32 FNC_VALUES 1 FLOAT32_IEEE COLUMN_DIR DIRECT /end RECORD_LAYOUT
/begin GROUP Acc_config "" ROOT
 /begin SUB_GROUP components.Globals components.Stecke components.AccFeedback components.OnOff components.FuSi interfaces.interfaces /end SUB_GROUP
/end GROUP
/begin GROUP components.Globals "" /begin REF_CHARACTERISTIC components.Globals.acc_status_request /end REF_CHARACTERISTIC
 /begin REF_MEASUREMENT components.Globals.acc_feedback components.Globals.acc_status components.Globals.v /end REF_MEASUREMENT
/end GROUP
/begin GROUP components.Stecke ""
 /begin REF_CHARACTERISTIC components.Stecke.BrakeMomentum components.Stecke.EngineMomentum components.Stecke.AirFriction components.Stecke.Landscape components.Stecke.TrackSize /end REF_CHARACTERISTIC
 /begin REF_MEASUREMENT components.Stecke.dh components.Stecke.ds components.Stecke.h components.Stecke.momentum components.Stecke.s /end REF_MEASUREMENT
/end GROUP
/begin GROUP components.AccFeedback "" /begin REF_CHARACTERISTIC components.AccFeedback.c /end REF_CHARACTERISTIC
 /begin REF_MEASUREMENT components.AccFeedback.acc_status_old components.AccFeedback.duration components.AccFeedback.feedback /end REF_MEASUREMENT
/end GROUP
/begin GROUP components.OnOff "" /end GROUP
/begin GROUP components.FuSi "" /end GROUP
/begin GROUP interfaces.interfaces ""
 /begin REF_MEASUREMENT interfaces.interfaces.crash_detected interfaces.interfaces.plusButtonPressed /end REF_MEASUREMENT
/end GROUP
/end MODULE
/end PROJECT
