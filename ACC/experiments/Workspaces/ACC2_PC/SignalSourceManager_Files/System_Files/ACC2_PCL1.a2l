ASAP2_VERSION 1 41
/begin PROJECT ACC2_PC "Generated by ETAS from Project ACC2_PC"
/begin HEADER "" VERSION "000" PROJECT_NO ASD /end HEADER
/begin MODULE ACC2_PC "Generated by ETAS ASCET7 from Project: ACC2_PC"
/begin IF_DATA E_TARGET
 /begin SOURCE "Task0" 3 /* period */ 10 QP_BLOB 1 /end SOURCE
 /begin TP_BLOB /* programm id */ 1300249015 /* target id */ 7 0 2 0 /end TP_BLOB
/end IF_DATA
/begin MOD_PAR "" VERSION "000" ADDR_EPK 0x0 EPK "" SUPPLIER "ETAS GmbH" CUSTOMER "xxx" CUSTOMER_NO "000" USER "xxx" PHONE_NO "000" ECU "PC" CPU_TYPE "PCx86" NO_OF_INTERFACES 1 /end MOD_PAR
/begin MOD_COMMON "Common definitions" BYTE_ORDER MSB_LAST ALIGNMENT_BYTE 1 ALIGNMENT_WORD 2 ALIGNMENT_LONG 4 ALIGNMENT_FLOAT32_IEEE 4 ALIGNMENT_FLOAT64_IEEE 8 /end MOD_COMMON
/begin MEASUREMENT components.ACC2.ACC_instance.sm "" /* datatype */ UBYTE /* conversion */ esdl_components_ACCStatemachineStates /* resolution */ 1 /* accuracy */ 100.0 /* lower limit */ 0 /* upper limit */ 1 ECU_ADDRESS 0x451028 /end MEASUREMENT
/begin MEASUREMENT components.ACC2.ACC_instance.x "" /* datatype */ FLOAT32_IEEE /* conversion */ esdl_ident /* resolution */ 1 /* accuracy */ 100.0 /* lower limit */ -3.4028234663852886E+38 /* upper limit */ 3.4028234663852886E+38 ECU_ADDRESS 0x451024 /end MEASUREMENT
/begin COMPU_METHOD esdl_components_ACCStatemachineStates "" TAB_VERB /* format */ "%12.4" /* unit */ "" /* compu_tab_ref */ COMPU_TAB_REF esdl_components_ACCStatemachineStates_vtab /end COMPU_METHOD
/begin COMPU_VTAB esdl_components_ACCStatemachineStates_vtab "" TAB_VERB /* number value pairs */ 2 /* value pair */ 0 "StateA" /* value pair */ 1 "StateB" /* default value */ DEFAULT_VALUE "Error" /end COMPU_VTAB
/begin COMPU_METHOD esdl_ident "" RAT_FUNC /* format */ "%12.4" /* unit */ "" /* coeffs */ COEFFS 0 1 0 0 0 1 /end COMPU_METHOD
/begin FUNCTION ACC2_PC "" /begin SUB_FUNCTION components.ACC2 /end SUB_FUNCTION /end FUNCTION
/begin FUNCTION components.ACC2 "" /begin SUB_FUNCTION components.ACC2.ACC_instance /end SUB_FUNCTION /end FUNCTION
/begin FUNCTION components.ACC2.ACC_instance ""
 /begin LOC_MEASUREMENT components.ACC2.ACC_instance.sm components.ACC2.ACC_instance.x /end LOC_MEASUREMENT
/end FUNCTION
/begin GROUP ACC2_PC "" ROOT /begin SUB_GROUP components.ACC2 /end SUB_GROUP /end GROUP
/begin GROUP components.ACC2 "" /begin SUB_GROUP components.ACC2.ACC_instance /end SUB_GROUP /end GROUP
/begin GROUP components.ACC2.ACC_instance ""
 /begin REF_MEASUREMENT components.ACC2.ACC_instance.sm components.ACC2.ACC_instance.x /end REF_MEASUREMENT
/end GROUP
/end MODULE
/end PROJECT
