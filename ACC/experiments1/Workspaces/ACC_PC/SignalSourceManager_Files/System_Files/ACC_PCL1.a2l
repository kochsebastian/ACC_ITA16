ASAP2_VERSION 1 41
/begin PROJECT ACC_PC "Generated by ETAS from Project ACC_PC"
/begin HEADER "" VERSION "000" PROJECT_NO ASD /end HEADER
/begin MODULE ACC_PC "Generated by ETAS ASCET7 from Project: ACC_PC"
/begin IF_DATA E_TARGET
 /begin SOURCE "Task0" 3 /* period */ 10 QP_BLOB 1 /end SOURCE
 /begin TP_BLOB /* programm id */ 1300255303 /* target id */ 7 0 2 0 /end TP_BLOB
/end IF_DATA
/begin MOD_PAR "" VERSION "000" ADDR_EPK 0x0 EPK "" SUPPLIER "ETAS GmbH" CUSTOMER "xxx" CUSTOMER_NO "000" USER "xxx" PHONE_NO "000" ECU "PC" CPU_TYPE "PCx86" NO_OF_INTERFACES 1 /end MOD_PAR
/begin MOD_COMMON "Common definitions" BYTE_ORDER MSB_LAST ALIGNMENT_BYTE 1 ALIGNMENT_WORD 2 ALIGNMENT_LONG 4 ALIGNMENT_FLOAT32_IEEE 4 ALIGNMENT_FLOAT64_IEEE 8 /end MOD_COMMON
/begin CHARACTERISTIC components.Globals.acc_status_request "" VALUE 0x453084 STANDARD_VALUE_U8 0.0 esdl_ident 0 1 BIT_MASK 0x1 /end CHARACTERISTIC
/begin CHARACTERISTIC components.Simulation.brakePadel "" VALUE 0x435000 STANDARD_VALUE_R32 0.0 esdl_ident -3.4028234663852886E+38 3.4028234663852886E+38 /end CHARACTERISTIC
/begin CHARACTERISTIC components.Simulation.gasPadel "" VALUE 0x435004 STANDARD_VALUE_R32 0.0 esdl_ident -3.4028234663852886E+38 3.4028234663852886E+38 /end CHARACTERISTIC
/begin CHARACTERISTIC components.Simulation.crash "" VALUE 0x435008 STANDARD_VALUE_U8 0.0 esdl_ident 0 1 BIT_MASK 0x1 /end CHARACTERISTIC
/begin CHARACTERISTIC components.Simulation.Stecke_instance.BrakeMomentum "" CURVE 0x43505C STANDARD_CURVE_R32R32 0.0 esdl_ident -3.4028234663852886E+38 3.4028234663852886E+38
 /begin AXIS_DESCR STD_AXIS NO_INPUT_QUANTITY esdl_ident 6 -3.4028234663852886E+38 3.4028234663852886E+38 /end AXIS_DESCR
/end CHARACTERISTIC
/begin CHARACTERISTIC components.Simulation.Stecke_instance.EngineMomentum "" MAP 0x435090 STANDARD_MAP_R32R32R32 0.0 esdl_ident -3.4028234663852886E+38 3.4028234663852886E+38
 /begin AXIS_DESCR STD_AXIS NO_INPUT_QUANTITY esdl_ident 6 -3.4028234663852886E+38 3.4028234663852886E+38 /end AXIS_DESCR
 /begin AXIS_DESCR STD_AXIS NO_INPUT_QUANTITY esdl_ident 6 -3.4028234663852886E+38 3.4028234663852886E+38 /end AXIS_DESCR
/end CHARACTERISTIC
/begin CHARACTERISTIC components.Simulation.Stecke_instance.AirFriction "" CURVE 0x435028 STANDARD_CURVE_R32R32 0.0 esdl_ident -3.4028234663852886E+38 3.4028234663852886E+38
 /begin AXIS_DESCR STD_AXIS NO_INPUT_QUANTITY esdl_ident 6 -3.4028234663852886E+38 3.4028234663852886E+38 /end AXIS_DESCR
/end CHARACTERISTIC
/begin CHARACTERISTIC components.Simulation.Stecke_instance.Landscape "" CURVE 0x435154 STANDARD_CURVE_R32R32 0.0 esdl_ident -3.4028234663852886E+38 3.4028234663852886E+38
 /begin AXIS_DESCR STD_AXIS NO_INPUT_QUANTITY esdl_ident 20 -3.4028234663852886E+38 3.4028234663852886E+38 /end AXIS_DESCR
/end CHARACTERISTIC
/begin CHARACTERISTIC components.Simulation.AccFeedback_instance.c "" VALUE 0x435024 STANDARD_VALUE_R32 0.0 esdl_ident -3.4028234663852886E+38 3.4028234663852886E+38 /end CHARACTERISTIC
/begin CHARACTERISTIC components.Simulation.ACC_Control_instance.fuenf "" VALUE 0x435014 STANDARD_VALUE_R32 0.0 esdl_ident -3.4028234663852886E+38 3.4028234663852886E+38 /end CHARACTERISTIC
/begin CHARACTERISTIC components.Simulation.ACC_Control_instance.decrease_power "" VALUE 0x435010 STANDARD_VALUE_R32 0.0 esdl_ident -3.4028234663852886E+38 3.4028234663852886E+38 /end CHARACTERISTIC
/begin CHARACTERISTIC components.Simulation.ACC_Control_instance.zero "" VALUE 0x435020 STANDARD_VALUE_R32 0.0 esdl_ident -3.4028234663852886E+38 3.4028234663852886E+38 /end CHARACTERISTIC
/begin CHARACTERISTIC components.Simulation.ACC_Control_instance.c_2 "" VALUE 0x43500C STANDARD_VALUE_R32 0.0 esdl_ident -3.4028234663852886E+38 3.4028234663852886E+38 /end CHARACTERISTIC
/begin CHARACTERISTIC components.Simulation.ACC_Control_instance.fuenfundneunzig "" VALUE 0x435018 STANDARD_VALUE_R32 0.0 esdl_ident -3.4028234663852886E+38 3.4028234663852886E+38 /end CHARACTERISTIC
/begin CHARACTERISTIC components.Simulation.ACC_Control_instance.hundert "" VALUE 0x43501C STANDARD_VALUE_R32 0.0 esdl_ident -3.4028234663852886E+38 3.4028234663852886E+38 /end CHARACTERISTIC
/begin MEASUREMENT components.Globals.acc_status "" UBYTE esdl_ident 1 100.0 0 1 ECU_ADDRESS 0x453085 BIT_MASK 0x1 /end MEASUREMENT
/begin MEASUREMENT components.Globals.acc_feedback "" UBYTE esdl_ident 1 100.0 0 1 ECU_ADDRESS 0x453086 BIT_MASK 0x1 /end MEASUREMENT
/begin MEASUREMENT components.Globals.TrackSize "" FLOAT32_IEEE esdl_ident 1 100.0 -3.4028234663852886E+38 3.4028234663852886E+38 ECU_ADDRESS 0x435200 /end MEASUREMENT
/begin MEASUREMENT components.Globals.v "" FLOAT32_IEEE esdl_ident 1 100.0 -3.4028234663852886E+38 3.4028234663852886E+38 ECU_ADDRESS 0x453080 /end MEASUREMENT
/begin MEASUREMENT components.Globals.z "" FLOAT32_IEEE esdl_ident 1 100.0 -3.4028234663852886E+38 3.4028234663852886E+38 ECU_ADDRESS 0x45307C /end MEASUREMENT
/begin MEASUREMENT components.Simulation.brakeVal "" FLOAT32_IEEE esdl_ident 1 100.0 -3.4028234663852886E+38 3.4028234663852886E+38 ECU_ADDRESS 0x453020 /end MEASUREMENT
/begin MEASUREMENT components.Simulation.powerVal "" FLOAT32_IEEE esdl_ident 1 100.0 -3.4028234663852886E+38 3.4028234663852886E+38 ECU_ADDRESS 0x453024 /end MEASUREMENT
/begin MEASUREMENT components.Simulation.Stecke_instance.h "" FLOAT32_IEEE esdl_ident 1 100.0 -3.4028234663852886E+38 3.4028234663852886E+38 ECU_ADDRESS 0x453054 /end MEASUREMENT
/begin MEASUREMENT components.Simulation.Stecke_instance.s "" FLOAT32_IEEE esdl_ident 1 100.0 -3.4028234663852886E+38 3.4028234663852886E+38 ECU_ADDRESS 0x45305C /end MEASUREMENT
/begin MEASUREMENT components.Simulation.Stecke_instance.ds "" FLOAT32_IEEE esdl_ident 1 100.0 -3.4028234663852886E+38 3.4028234663852886E+38 ECU_ADDRESS 0x453050 /end MEASUREMENT
/begin MEASUREMENT components.Simulation.Stecke_instance.momentum "" FLOAT32_IEEE esdl_ident 1 100.0 -3.4028234663852886E+38 3.4028234663852886E+38 ECU_ADDRESS 0x453058 /end MEASUREMENT
/begin MEASUREMENT components.Simulation.Stecke_instance.dh "" FLOAT32_IEEE esdl_ident 1 100.0 -3.4028234663852886E+38 3.4028234663852886E+38 ECU_ADDRESS 0x45304C /end MEASUREMENT
/begin MEASUREMENT components.Simulation.Stecke_instance.TrackSize "" FLOAT32_IEEE esdl_ident 1 100.0 -3.4028234663852886E+38 3.4028234663852886E+38 ECU_ADDRESS 0x453048 /end MEASUREMENT
/begin MEASUREMENT components.Simulation.AccFeedback_instance.acc_status_old "" UBYTE esdl_ident 1 100.0 0 1 ECU_ADDRESS 0x45303C BIT_MASK 0x1 /end MEASUREMENT
/begin MEASUREMENT components.Simulation.AccFeedback_instance.feedback "" UBYTE esdl_ident 1 100.0 0 1 ECU_ADDRESS 0x45303D BIT_MASK 0x1 /end MEASUREMENT
/begin MEASUREMENT components.Simulation.AccFeedback_instance.duration "" FLOAT32_IEEE esdl_ident 1 100.0 -3.4028234663852886E+38 3.4028234663852886E+38 ECU_ADDRESS 0x453038 /end MEASUREMENT
/begin MEASUREMENT components.Simulation.ACC_Control_instance.v_set "" FLOAT32_IEEE esdl_ident 1 100.0 -3.4028234663852886E+38 3.4028234663852886E+38 ECU_ADDRESS 0x453034 /end MEASUREMENT
/begin MEASUREMENT components.Simulation.ACC_Control_instance.v_2 "" FLOAT32_IEEE esdl_ident 1 100.0 -3.4028234663852886E+38 3.4028234663852886E+38 ECU_ADDRESS 0x453030 /end MEASUREMENT
/begin MEASUREMENT components.Simulation.ACC_Control_instance.power_return "" FLOAT32_IEEE esdl_ident 1 100.0 -3.4028234663852886E+38 3.4028234663852886E+38 ECU_ADDRESS 0x45302C /end MEASUREMENT
/begin MEASUREMENT components.Simulation.ACC_Control_instance.brake_return "" FLOAT32_IEEE esdl_ident 1 100.0 -3.4028234663852886E+38 3.4028234663852886E+38 ECU_ADDRESS 0x453028 /end MEASUREMENT
/begin MEASUREMENT components.Simulation.DetectCurrentVelocity_instance.acc_status_old "" UBYTE esdl_ident 1 100.0 0 1 ECU_ADDRESS 0x453044 BIT_MASK 0x1 /end MEASUREMENT
/begin MEASUREMENT components.Simulation.DetectCurrentVelocity_instance.status_old "" UBYTE esdl_ident 1 100.0 0 1 ECU_ADDRESS 0x453045 BIT_MASK 0x1 /end MEASUREMENT
/begin MEASUREMENT components.Simulation.DetectCurrentVelocity_instance.v_buffer "" FLOAT32_IEEE esdl_ident 1 100.0 -3.4028234663852886E+38 3.4028234663852886E+38 ECU_ADDRESS 0x453040 /end MEASUREMENT
/begin MEASUREMENT interfaces.interfaces.crash_detected "" UBYTE esdl_ident 1 100.0 0 1 ECU_ADDRESS 0x453062 BIT_MASK 0x1 /end MEASUREMENT
/begin MEASUREMENT interfaces.interfaces.plusButtonPressed "" UBYTE esdl_ident 1 100.0 0 1 ECU_ADDRESS 0x453061 BIT_MASK 0x1 /end MEASUREMENT
/begin MEASUREMENT interfaces.interfaces.brake "" FLOAT32_IEEE esdl_ident 1 100.0 -3.4028234663852886E+38 3.4028234663852886E+38 ECU_ADDRESS 0x453074 /end MEASUREMENT
/begin MEASUREMENT interfaces.interfaces.power "" FLOAT32_IEEE esdl_ident 1 100.0 -3.4028234663852886E+38 3.4028234663852886E+38 ECU_ADDRESS 0x453068 /end MEASUREMENT
/begin MEASUREMENT interfaces.interfaces.v "" FLOAT32_IEEE esdl_ident 1 100.0 -3.4028234663852886E+38 3.4028234663852886E+38 ECU_ADDRESS 0x453064 /end MEASUREMENT
/begin MEASUREMENT interfaces.interfaces.gasPedel "" FLOAT32_IEEE esdl_ident 1 100.0 -3.4028234663852886E+38 3.4028234663852886E+38 ECU_ADDRESS 0x45306C /end MEASUREMENT
/begin MEASUREMENT interfaces.interfaces.brakePadel "" FLOAT32_IEEE esdl_ident 1 100.0 -3.4028234663852886E+38 3.4028234663852886E+38 ECU_ADDRESS 0x453070 /end MEASUREMENT
/begin MEASUREMENT interfaces.interfaces.request "" UBYTE esdl_ident 1 100.0 0 1 ECU_ADDRESS 0x453060 BIT_MASK 0x1 /end MEASUREMENT
/begin COMPU_METHOD esdl_ident "" RAT_FUNC /* format */ "%12.4" /* unit */ "" /* coeffs */ COEFFS 0 1 0 0 0 1 /end COMPU_METHOD
/begin FUNCTION ACC_PC "" /begin SUB_FUNCTION components.Globals components.Simulation /end SUB_FUNCTION /end FUNCTION
/begin FUNCTION components.Globals "" /begin DEF_CHARACTERISTIC components.Globals.acc_status_request /end DEF_CHARACTERISTIC
 /begin LOC_MEASUREMENT components.Globals.TrackSize components.Globals.acc_feedback components.Globals.acc_status components.Globals.v components.Globals.z /end LOC_MEASUREMENT
/end FUNCTION
/begin FUNCTION components.Simulation ""
 /begin DEF_CHARACTERISTIC components.Simulation.brakePadel components.Simulation.gasPadel components.Simulation.crash /end DEF_CHARACTERISTIC
 /begin IN_MEASUREMENT interfaces.interfaces.brake interfaces.interfaces.power /end IN_MEASUREMENT
 /begin OUT_MEASUREMENT interfaces.interfaces.power interfaces.interfaces.v /end OUT_MEASUREMENT
 /begin LOC_MEASUREMENT components.Simulation.brakeVal components.Simulation.powerVal /end LOC_MEASUREMENT
 /begin SUB_FUNCTION components.Simulation.Stecke_instance components.Simulation.OnOff_instance components.Simulation.AccFeedback_instance components.Simulation.ACC_Control_instance components.Simulation.DetectCurrentVelocity_instance components.Simulation.FuSi_instance /end SUB_FUNCTION
/end FUNCTION
/begin FUNCTION components.Simulation.Stecke_instance ""
 /begin DEF_CHARACTERISTIC components.Simulation.Stecke_instance.BrakeMomentum components.Simulation.Stecke_instance.EngineMomentum components.Simulation.Stecke_instance.AirFriction components.Simulation.Stecke_instance.Landscape /end DEF_CHARACTERISTIC
 /begin LOC_MEASUREMENT components.Simulation.Stecke_instance.TrackSize components.Simulation.Stecke_instance.dh components.Simulation.Stecke_instance.ds components.Simulation.Stecke_instance.h components.Simulation.Stecke_instance.momentum components.Simulation.Stecke_instance.s /end LOC_MEASUREMENT
/end FUNCTION
/begin FUNCTION components.Simulation.OnOff_instance "" /end FUNCTION
/begin FUNCTION components.Simulation.AccFeedback_instance "" /begin DEF_CHARACTERISTIC components.Simulation.AccFeedback_instance.c /end DEF_CHARACTERISTIC
 /begin LOC_MEASUREMENT components.Simulation.AccFeedback_instance.acc_status_old components.Simulation.AccFeedback_instance.duration components.Simulation.AccFeedback_instance.feedback /end LOC_MEASUREMENT
/end FUNCTION
/begin FUNCTION components.Simulation.ACC_Control_instance ""
 /begin DEF_CHARACTERISTIC components.Simulation.ACC_Control_instance.fuenf components.Simulation.ACC_Control_instance.decrease_power components.Simulation.ACC_Control_instance.zero components.Simulation.ACC_Control_instance.c_2 components.Simulation.ACC_Control_instance.fuenfundneunzig components.Simulation.ACC_Control_instance.hundert /end DEF_CHARACTERISTIC
 /begin LOC_MEASUREMENT components.Simulation.ACC_Control_instance.brake_return components.Simulation.ACC_Control_instance.power_return components.Simulation.ACC_Control_instance.v_2 components.Simulation.ACC_Control_instance.v_set /end LOC_MEASUREMENT
/end FUNCTION
/begin FUNCTION components.Simulation.DetectCurrentVelocity_instance ""
 /begin LOC_MEASUREMENT components.Simulation.DetectCurrentVelocity_instance.acc_status_old components.Simulation.DetectCurrentVelocity_instance.status_old components.Simulation.DetectCurrentVelocity_instance.v_buffer /end LOC_MEASUREMENT
/end FUNCTION
/begin FUNCTION components.Simulation.FuSi_instance "" /end FUNCTION
/begin RECORD_LAYOUT STANDARD_VALUE_U8 FNC_VALUES 1 UBYTE COLUMN_DIR DIRECT /end RECORD_LAYOUT
/begin RECORD_LAYOUT STANDARD_VALUE_R32 FNC_VALUES 1 FLOAT32_IEEE COLUMN_DIR DIRECT /end RECORD_LAYOUT
/begin RECORD_LAYOUT STANDARD_CURVE_R32R32 /* axis size */ NO_AXIS_PTS_X 1 UWORD /* axis */ AXIS_PTS_X 2 FLOAT32_IEEE INDEX_INCR DIRECT FNC_VALUES 3 FLOAT32_IEEE COLUMN_DIR DIRECT /end RECORD_LAYOUT
/begin RECORD_LAYOUT STANDARD_MAP_R32R32R32 /* x axis size */ NO_AXIS_PTS_X 1 UWORD /* y axis size */ NO_AXIS_PTS_Y 2 UWORD /* x axis */ AXIS_PTS_X 3 FLOAT32_IEEE INDEX_INCR DIRECT /* y axis */ AXIS_PTS_Y 4 FLOAT32_IEEE INDEX_INCR DIRECT FNC_VALUES 5 FLOAT32_IEEE COLUMN_DIR DIRECT /end RECORD_LAYOUT
/begin GROUP ACC_PC "" ROOT
 /begin SUB_GROUP components.Globals components.Simulation interfaces.interfaces /end SUB_GROUP
/end GROUP
/begin GROUP components.Globals "" /begin REF_CHARACTERISTIC components.Globals.acc_status_request /end REF_CHARACTERISTIC
 /begin REF_MEASUREMENT components.Globals.TrackSize components.Globals.acc_feedback components.Globals.acc_status components.Globals.v components.Globals.z /end REF_MEASUREMENT
/end GROUP
/begin GROUP components.Simulation ""
 /begin REF_CHARACTERISTIC components.Simulation.brakePadel components.Simulation.gasPadel components.Simulation.crash /end REF_CHARACTERISTIC
 /begin REF_MEASUREMENT components.Simulation.brakeVal components.Simulation.powerVal /end REF_MEASUREMENT
 /begin SUB_GROUP components.Simulation.Stecke_instance components.Simulation.OnOff_instance components.Simulation.AccFeedback_instance components.Simulation.ACC_Control_instance components.Simulation.DetectCurrentVelocity_instance components.Simulation.FuSi_instance /end SUB_GROUP
/end GROUP
/begin GROUP components.Simulation.Stecke_instance ""
 /begin REF_CHARACTERISTIC components.Simulation.Stecke_instance.BrakeMomentum components.Simulation.Stecke_instance.EngineMomentum components.Simulation.Stecke_instance.AirFriction components.Simulation.Stecke_instance.Landscape /end REF_CHARACTERISTIC
 /begin REF_MEASUREMENT components.Simulation.Stecke_instance.TrackSize components.Simulation.Stecke_instance.dh components.Simulation.Stecke_instance.ds components.Simulation.Stecke_instance.h components.Simulation.Stecke_instance.momentum components.Simulation.Stecke_instance.s /end REF_MEASUREMENT
/end GROUP
/begin GROUP components.Simulation.OnOff_instance "" /end GROUP
/begin GROUP components.Simulation.AccFeedback_instance "" /begin REF_CHARACTERISTIC components.Simulation.AccFeedback_instance.c /end REF_CHARACTERISTIC
 /begin REF_MEASUREMENT components.Simulation.AccFeedback_instance.acc_status_old components.Simulation.AccFeedback_instance.duration components.Simulation.AccFeedback_instance.feedback /end REF_MEASUREMENT
/end GROUP
/begin GROUP components.Simulation.ACC_Control_instance ""
 /begin REF_CHARACTERISTIC components.Simulation.ACC_Control_instance.fuenf components.Simulation.ACC_Control_instance.decrease_power components.Simulation.ACC_Control_instance.zero components.Simulation.ACC_Control_instance.c_2 components.Simulation.ACC_Control_instance.fuenfundneunzig components.Simulation.ACC_Control_instance.hundert /end REF_CHARACTERISTIC
 /begin REF_MEASUREMENT components.Simulation.ACC_Control_instance.brake_return components.Simulation.ACC_Control_instance.power_return components.Simulation.ACC_Control_instance.v_2 components.Simulation.ACC_Control_instance.v_set /end REF_MEASUREMENT
/end GROUP
/begin GROUP components.Simulation.DetectCurrentVelocity_instance ""
 /begin REF_MEASUREMENT components.Simulation.DetectCurrentVelocity_instance.acc_status_old components.Simulation.DetectCurrentVelocity_instance.status_old components.Simulation.DetectCurrentVelocity_instance.v_buffer /end REF_MEASUREMENT
/end GROUP
/begin GROUP components.Simulation.FuSi_instance "" /end GROUP
/begin GROUP interfaces.interfaces ""
 /begin REF_MEASUREMENT interfaces.interfaces.brake interfaces.interfaces.brakePadel interfaces.interfaces.crash_detected interfaces.interfaces.gasPedel interfaces.interfaces.plusButtonPressed interfaces.interfaces.power interfaces.interfaces.request interfaces.interfaces.v /end REF_MEASUREMENT
/end GROUP
/end MODULE
/end PROJECT
